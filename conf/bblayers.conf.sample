## conf/bblayers.conf.sample
```bitbake
# LAYER_CONF_VERSION is increased each time build/conf/bblayers.conf
# changes incompatibly
LCONF_VERSION = "6"

BBPATH = "${TOPDIR}"
BBFILES ?= ""

BBLAYERS ?= " \
  ##OEROOT##/meta \
  ##OEROOT##/meta-yocto \
  ##OEROOT##/meta-yocto-bsp \
  ##OEROOT##/../meta-agl/meta-ivi-common \
  ##OEROOT##/../meta-agl/meta-agl \
  ##OEROOT##/../meta-agl/meta-agl-bsp \
  ##OEROOT##/../meta-openembedded/meta-oe \
  ##OEROOT##/../meta-agl-demo \
  "
BBLAYERS_NON_REMOVABLE ?= " \
  ##OEROOT##/meta \
  ##OEROOT##/meta-yocto \
  ##OEROOT##/../meta-agl/meta-agl \
  "
```

## templates/dragonboard-410c/conf/bblayers.conf.sample
```bitbake
# LAYER_CONF_VERSION is increased each time build/conf/bblayers.conf
# changes incompatibly
LCONF_VERSION = "6"

BBPATH = "${TOPDIR}"
BBFILES ?= ""

# AGL layers for DragonBoard-410c
BBLAYERS ?= " \
  ##OEROOT##/meta \
  ##OEROOT##/meta-yocto \
  ##OEROOT##/meta-yocto-bsp \
  ##OEROOT##/../meta-agl/meta-ivi-common \
  ##OEROOT##/../meta-agl/meta-agl \
  ##OEROOT##/../meta-agl/meta-agl-bsp \
  ##OEROOT##/../meta-agl/meta-agl-security \
  ##OEROOT##/../meta-agl/meta-app-framework \
  ##OEROOT##/../meta-intel-iot-security/meta-security-smack \
  ##OEROOT##/../meta-intel-iot-security/meta-security-framework \
  ##OEROOT##/../meta-openembedded/meta-oe \
  ##OEROOT##/../meta-openembedded/meta-multimedia \
  ##OEROOT##/../meta-openembedded/meta-efl \
  ##OEROOT##/../meta-openembedded/meta-networking \
  ##OEROOT##/../meta-openembedded/meta-python \
  ##OEROOT##/../meta-openembedded/meta-filesystems \
  ##OEROOT##/../meta-qcom \
  ##OEROOT##/../meta-agl-demo \
  ##OEROOT##/../meta-openembedded/meta-ruby \
  ##OEROOT##/../meta-qt5 \
  ##OEROOT##/../meta-rust \
  "
BBLAYERS_NON_REMOVABLE ?= " \
  ##OEROOT##/meta \
  ##OEROOT##/meta-yocto \
  ##OEROOT##/../meta-agl/meta-agl \
  "
```
